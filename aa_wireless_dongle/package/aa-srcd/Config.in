## aa_wireless_dongle/package/aa-srcd/Config.in
```kconfig
config BR2_PACKAGE_AA_SRCD
	bool "aa-srcd"
	select BR2_PACKAGE_OPENSSL
	select BR2_PACKAGE_X264
	select BR2_PACKAGE_LVGL
	help
	  Android Auto source daemon: the Raspberry Pi plays the role of the
	  phone and projects its own video (an LVGL dashboard, or a pre-encoded
	  H.264 stream) on a head unit, with no phone involved.

	  Enable it with AA_SRC_ENABLED=1 in /etc/aa-srcd.conf; that also turns
	  off the aawgd proxy, since both want the USB accessory device.
```

## aa_wireless_dongle/package/lvgl/Config.in
```kconfig
config BR2_PACKAGE_LVGL
	bool "lvgl"
	help
	  Light and Versatile Graphics Library, compiled here as a static library
	  with our own lv_conf.h and only the software renderer. Used by aa-srcd
	  to draw the dashboard that gets projected over Android Auto.

	  https://lvgl.io
```
